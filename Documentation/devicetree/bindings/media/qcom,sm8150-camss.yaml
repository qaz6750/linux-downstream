## Documentation/devicetree/bindings/media/qcom,sm8150-venus.yaml
```yaml
# SPDX-License-Identifier: (GPL-2.0 OR BSD-2-Clause)
%YAML 1.2
---
$id: http://devicetree.org/schemas/media/qcom,sm8150-venus.yaml#
$schema: http://devicetree.org/meta-schemas/core.yaml#

title: Qualcomm SM8150 Venus video encode and decode accelerators

maintainers:
  - Stanimir Varbanov <stanimir.varbanov@linaro.org>

description: |
  The Venus IP is a video encode and decode accelerator present
  on Qualcomm platforms

allOf:
  - $ref: qcom,venus-common.yaml#

properties:
  compatible:
    const: qcom,sm8150-venus

  power-domains:
    minItems: 3
    maxItems: 4

  power-domain-names:
    minItems: 3
    items:
      - const: venus
      - const: vcodec0
      - const: vcodec1
      - const: cx

  clocks:
    maxItems: 7

  clock-names:
    items:
      - const: core
      - const: iface
      - const: bus
      - const: vcodec0_core
      - const: vcodec0_bus
      - const: vcodec1_core
      - const: vcodec1_bus

  iommus:
    maxItems: 1

  interconnects:
    maxItems: 2

  interconnect-names:
    items:
      - const: video-mem
      - const: cpu-cfg

  operating-points-v2: true
  opp-table:
    type: object

  video-core0:
    type: object

    properties:
      compatible:
        const: venus-decoder

    required:
      - compatible

    deprecated: true
    additionalProperties: false

  video-core1:
    type: object

    properties:
      compatible:
        const: venus-encoder

    required:
      - compatible

    deprecated: true
    additionalProperties: false

required:
  - compatible
  - power-domain-names
  - iommus

unevaluatedProperties: false

examples:
  - |
    #include <dt-bindings/interrupt-controller/arm-gic.h>
    #include <dt-bindings/clock/qcom,videocc-sm8150.h>

    video-codec@aa00000 {
        compatible = "qcom,sm8150-venus";
        reg = <0x0aa00000 0xff000>;
        interrupts = <GIC_SPI 174 IRQ_TYPE_LEVEL_HIGH>;
        clocks = <&videocc VIDEO_CC_MVSC_CORE_CLK>,
                 <&videocc VIDEO_CC_IRIS_AHB_CLK>,
                 <&gcc GCC_VIDEO_AXIC_CLK>,
                 <&videocc VIDEO_CC_MVS0_CORE_CLK>,
                 <&gcc GCC_VIDEO_AXI0_CLK>,
                 <&videocc VIDEO_CC_MVS1_CORE_CLK>,
                 <&gcc GCC_VIDEO_AXI1_CLK>;
        clock-names = "core", "iface", "bus",
                      "vcodec0_core", "vcodec0_bus",
                      "vcodec1_core", "vcodec1_bus";
        power-domains = <&videocc VENUS_GDSC>,
                        <&videocc VCODEC0_GDSC>,
                        <&videocc VCODEC1_GDSC>;
        power-domain-names = "venus", "vcodec0", "vcodec1";
        iommus = <&apps_smmu 0x1300 0x60>;
        memory-region = <&venus_mem>;
    };
```

## Documentation/devicetree/bindings/power/supply/idt,p9418.yaml
```yaml
# SPDX-License-Identifier: GPL-2.0
%YAML 1.2
---
$id: http://devicetree.org/schemas/power/supply/idt,p9418.yaml#
$schema: http://devicetree.org/meta-schemas/core.yaml#

title: IDT P9418 Wireless Power Charger

maintainers:
  - Viola Guerrera <viooo@anche.no>

properties:
  compatible:
    const: idt,p9418

  reg:
    maxItems: 1
    description: I2C address of the device

  irq-gpios:
    maxItems: 1
    description: |
      GPIO used as the interrupt line from the chip to the host.

  pen-det-active-high-gpios:
    maxItems: 1
    description: |
      GPIO used to detect pen presence (active high).

  pen-det-active-low-gpios:
    maxItems: 1
    description: |
      GPIO used to detect pen presence (active low).

  enable-gpios:
    maxItems: 1
    description: |
      GPIO used to enable or disable the wireless power transmitter chip.

  boost-enable-gpios:
    maxItems: 1
    description: |
      GPIO used to enable the boost converter for reverse charging.

  '#address-cells':
    const: 1

  '#size-cells':
    const: 0

required:
  - compatible
  - reg
  - enable-gpios
  - boost-enable-gpios

additionalProperties: false

examples:
  - |
    #include <dt-bindings/gpio/gpio.h>

    i2c17: i2c@17 {
        status = "okay";

        idtp9418: idtp9418@3b {
            compatible = "idt,p9418";
            reg = <0x3b>;
            status = "okay";
            irq-gpios = <&tlmm 95 GPIO_ACTIVE_LOW>;
            pen-det-active-high-gpios = <&tlmm 101 GPIO_ACTIVE_HIGH>;
            pen-det-active-low-gpios = <&tlmm 134 GPIO_ACTIVE_HIGH>;
            enable-gpios = <&tlmm 3 GPIO_ACTIVE_HIGH>;
            boost-enable-gpios = <&tlmm 47 GPIO_ACTIVE_HIGH>;
        };
    };
...
```
